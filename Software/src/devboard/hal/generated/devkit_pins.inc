// GENERATED by tools/board_gen.py from Software/boards/devkit.yaml
// Do not edit: edit the board declaration and regenerate.
// Included inside the board class body; pins that depend on a runtime
// user setting are hand-written in the board header, not here.


  const char* name() { return "ESP32 DevKit V1"; }

  virtual gpio_num_t RS485_TX_PIN() { return GPIO_NUM_1; }
  virtual gpio_num_t RS485_RX_PIN() { return GPIO_NUM_3; }
  virtual gpio_num_t CAN_TX_PIN() { return GPIO_NUM_27; }
  virtual gpio_num_t CAN_RX_PIN() { return GPIO_NUM_26; }
  virtual gpio_num_t MCP2515_SCK() { return GPIO_NUM_22; }
  virtual gpio_num_t MCP2515_MOSI() { return GPIO_NUM_21; }
  virtual gpio_num_t MCP2515_MISO() { return GPIO_NUM_19; }
  virtual gpio_num_t MCP2515_CS() { return GPIO_NUM_18; }
  virtual gpio_num_t MCP2515_INT() { return GPIO_NUM_23; }
  virtual gpio_num_t MCP2517_SCK() { return GPIO_NUM_33; }
  virtual gpio_num_t MCP2517_SDI() { return GPIO_NUM_32; }
  virtual gpio_num_t MCP2517_SDO() { return GPIO_NUM_35; }
  virtual gpio_num_t MCP2517_CS() { return GPIO_NUM_25; }
  virtual gpio_num_t MCP2517_INT() { return GPIO_NUM_34; }
  virtual gpio_num_t POSITIVE_CONTACTOR_PIN() { return GPIO_NUM_5; }
  virtual gpio_num_t NEGATIVE_CONTACTOR_PIN() { return GPIO_NUM_16; }
  virtual gpio_num_t PRECHARGE_PIN() { return GPIO_NUM_17; }
  virtual gpio_num_t SECOND_BATTERY_CONTACTORS_PIN() { return GPIO_NUM_32; }
  virtual gpio_num_t TRIPLE_BATTERY_CONTACTORS_PIN() { return GPIO_NUM_NC; }
  virtual gpio_num_t HIA4V1_PIN() { return GPIO_NUM_4; }
  virtual gpio_num_t INVERTER_DISCONNECT_CONTACTOR_PIN() { return GPIO_NUM_5; }
  virtual gpio_num_t INVERTER_CONTACTOR_ENABLE_PIN() { return GPIO_NUM_14; }
  virtual gpio_num_t INVERTER_CONTACTOR_ENABLE_LED_PIN() { return GPIO_NUM_2; }
  virtual gpio_num_t LED_PIN() { return GPIO_NUM_4; }
  virtual gpio_num_t EQUIPMENT_STOP_PIN() { return GPIO_NUM_12; }
  virtual gpio_num_t WUP_PIN1() { return GPIO_NUM_25; }
  virtual gpio_num_t WUP_PIN2() { return GPIO_NUM_32; }
  virtual gpio_num_t AP_BUTTON_PIN() { return GPIO_NUM_0; }
  virtual uint8_t LED_MAX_BRIGHTNESS() { return 40; }
