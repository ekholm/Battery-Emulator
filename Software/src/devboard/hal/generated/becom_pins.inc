// GENERATED by tools/board_gen.py from Software/boards/becom.yaml
// Do not edit: edit the board declaration and regenerate.
// Included inside the board class body; pins that depend on a runtime
// user setting are hand-written in the board header, not here.


  const char* name() { return "BECom"; }

  virtual gpio_num_t CAN_TX_PIN() { return GPIO_NUM_8; }
  virtual gpio_num_t CAN_RX_PIN() { return GPIO_NUM_18; }
  virtual gpio_num_t RS485_TX_PIN() { return GPIO_NUM_15; }
  virtual gpio_num_t RS485_RX_PIN() { return GPIO_NUM_17; }
  virtual gpio_num_t RS485_DE_PIN() { return GPIO_NUM_16; }
  virtual gpio_num_t MCP2517_SCK() { return GPIO_NUM_12; }
  virtual gpio_num_t MCP2517_SDI() { return GPIO_NUM_11; }
  virtual gpio_num_t MCP2517_SDO() { return GPIO_NUM_13; }
  virtual gpio_num_t MCP2517_CS() { return GPIO_NUM_14; }
  virtual gpio_num_t MCP2517_INT() { return GPIO_NUM_10; }
  virtual gpio_num_t MCP2517_CS2() { return GPIO_NUM_21; }
  virtual gpio_num_t MCP2517_INT2() { return GPIO_NUM_9; }
  virtual gpio_num_t POSITIVE_CONTACTOR_PIN() { return GPIO_NUM_47; }
  virtual gpio_num_t NEGATIVE_CONTACTOR_PIN() { return GPIO_NUM_48; }
  virtual gpio_num_t PRECHARGE_PIN() { return GPIO_NUM_45; }
  virtual gpio_num_t BMS_POWER() { return GPIO_NUM_1; }
  virtual gpio_num_t SECOND_BATTERY_CONTACTORS_PIN() { return GPIO_NUM_37; }
  virtual gpio_num_t HIA4V1_PIN() { return GPIO_NUM_45; }
  virtual gpio_num_t INVERTER_DISCONNECT_CONTACTOR_PIN() { return GPIO_NUM_47; }
  virtual gpio_num_t INVERTER_CONTACTOR_ENABLE_PIN() { return GPIO_NUM_3; }
  virtual gpio_num_t LED_PIN() { return GPIO_NUM_5; }
  virtual gpio_num_t EQUIPMENT_STOP_PIN() { return GPIO_NUM_46; }
  virtual gpio_num_t WUP_PIN1() { return GPIO_NUM_2; }
  virtual gpio_num_t WUP_PIN2() { return GPIO_NUM_41; }
  virtual gpio_num_t AP_BUTTON_PIN() { return GPIO_NUM_0; }
  virtual uint32_t MCP2517_FREQ() { return 40000000; }
  virtual uint32_t MCP2517_FREQ2() { return 40000000; }
  virtual int MCP2517_CLKODIV() { return 0b00; }
  virtual uint8_t LED_MAX_BRIGHTNESS() { return 40; }
