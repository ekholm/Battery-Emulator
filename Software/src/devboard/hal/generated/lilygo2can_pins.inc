// GENERATED by tools/board_gen.py from Software/boards/lilygo2can.yaml
// Do not edit: edit the board declaration and regenerate.
// Included inside the board class body; pins that depend on a runtime
// user setting are hand-written in the board header, not here.


  const char* name() { return "LilyGo T_2CAN"; }

  virtual gpio_num_t CAN_TX_PIN() { return GPIO_NUM_7; }
  virtual gpio_num_t CAN_RX_PIN() { return GPIO_NUM_6; }
  virtual gpio_num_t RS485_TX_PIN() { return GPIO_NUM_43; }
  virtual gpio_num_t RS485_RX_PIN() { return GPIO_NUM_44; }
  virtual gpio_num_t POSITIVE_CONTACTOR_PIN() { return GPIO_NUM_48; }
  virtual gpio_num_t NEGATIVE_CONTACTOR_PIN() { return GPIO_NUM_17; }
  virtual gpio_num_t PRECHARGE_PIN() { return GPIO_NUM_21; }
  virtual gpio_num_t SECOND_BATTERY_CONTACTORS_PIN() { return GPIO_NUM_5; }
  virtual gpio_num_t TRIPLE_BATTERY_CONTACTORS_PIN() { return GPIO_NUM_4; }
  virtual gpio_num_t HIA4V1_PIN() { return GPIO_NUM_18; }
  virtual gpio_num_t INVERTER_DISCONNECT_CONTACTOR_PIN() { return GPIO_NUM_14; }
  virtual gpio_num_t INVERTER_CONTACTOR_ENABLE_PIN() { return GPIO_NUM_46; }
  virtual gpio_num_t LED_PIN() { return GPIO_NUM_35; }
  virtual gpio_num_t CHADEMO_PIN_2() { return GPIO_NUM_16; }
  virtual gpio_num_t CHADEMO_PIN_10() { return GPIO_NUM_15; }
  virtual gpio_num_t CHADEMO_PIN_7() { return GPIO_NUM_47; }
  virtual gpio_num_t CHADEMO_PIN_4() { return GPIO_NUM_4; }
  virtual gpio_num_t CHADEMO_LOCK() { return GPIO_NUM_40; }
  virtual gpio_num_t AP_BUTTON_PIN() { return GPIO_NUM_0; }
  virtual uint32_t MCP2515_FREQ() { return 16000000; }
  virtual uint32_t MCP2517_FREQ() { return is_fd() ? 40000000 : 0; }
  virtual uint8_t MCP2517_BUS2() { return DEFAULT_MCP2515_BUS; }
  virtual uint8_t LED_MAX_BRIGHTNESS() { return 40; }
