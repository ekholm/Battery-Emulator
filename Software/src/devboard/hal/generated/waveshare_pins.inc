// GENERATED by tools/board_gen.py from Software/boards/waveshare.yaml
// Do not edit: edit the board declaration and regenerate.
// Included inside the board class body; pins that depend on a runtime
// user setting are hand-written in the board header, not here.


  const char* name() { return "Waveshare ESP32-S3-RS485-CAN"; }

  virtual gpio_num_t CAN_TX_PIN() { return GPIO_NUM_15; }
  virtual gpio_num_t CAN_RX_PIN() { return GPIO_NUM_16; }
  virtual gpio_num_t CAN_SE_PIN() { return GPIO_NUM_NC; }
  virtual gpio_num_t RS485_TX_PIN() { return GPIO_NUM_17; }
  virtual gpio_num_t RS485_RX_PIN() { return GPIO_NUM_18; }
  virtual gpio_num_t RS485_DE_PIN() { return GPIO_NUM_21; }
  virtual gpio_num_t RS485_EN_PIN() { return GPIO_NUM_NC; }
  virtual gpio_num_t RS485_SE_PIN() { return GPIO_NUM_NC; }
  virtual gpio_num_t PIN_5V_EN() { return GPIO_NUM_NC; }
  virtual gpio_num_t POSITIVE_CONTACTOR_PIN() { return GPIO_NUM_3; }
  virtual gpio_num_t NEGATIVE_CONTACTOR_PIN() { return GPIO_NUM_4; }
  virtual gpio_num_t PRECHARGE_PIN() { return GPIO_NUM_5; }
  virtual gpio_num_t BMS_POWER() { return GPIO_NUM_6; }
  virtual gpio_num_t SECOND_BATTERY_CONTACTORS_PIN() { return GPIO_NUM_8; }
  virtual gpio_num_t EQUIPMENT_STOP_PIN() { return GPIO_NUM_7; }
  virtual gpio_num_t WUP_PIN1() { return GPIO_NUM_8; }
  virtual gpio_num_t AP_BUTTON_PIN() { return GPIO_NUM_0; }
  virtual gpio_num_t HIA4V1_PIN() { return GPIO_NUM_5; }
  virtual gpio_num_t INVERTER_DISCONNECT_CONTACTOR_PIN() { return GPIO_NUM_3; }
  virtual gpio_num_t INVERTER_CONTACTOR_ENABLE_PIN() { return GPIO_NUM_9; }
  virtual gpio_num_t MCP2517_SCK() { return GPIO_NUM_10; }
  virtual gpio_num_t MCP2517_SDI() { return GPIO_NUM_11; }
  virtual gpio_num_t MCP2517_SDO() { return GPIO_NUM_12; }
  virtual gpio_num_t MCP2517_CS() { return GPIO_NUM_13; }
  virtual gpio_num_t MCP2517_INT() { return GPIO_NUM_14; }
