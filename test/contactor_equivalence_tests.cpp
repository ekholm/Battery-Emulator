// Capture-compare equivalence tests for the contactor refactor.
//
// The BMW i3 and BMW S-BOX drivers had their hand-rolled contactor state
// machines replaced by the shared PrechargeFsm. Neither has hardware in this
// project and neither has a CAN log, so "behaviour-identical" was an unbacked
// claim. These tests make it a checked one: each scenario scripts the inputs
// the driver reacts to and asserts that the frames it puts on the wire are
// byte-identical to what the pre-refactor implementation emitted.
//
// The .trace files were generated by running the same scenarios against
// upstream/main (the pre-refactor code) - see test/contactor_traces/README.md.
// A diff here means the refactor changed what the hardware would see, which is
// exactly the failure the refactor promised not to have.

#include <gtest/gtest.h>
#include <cstdio>
#include <fstream>
#include <string>
#include <vector>

#include <Arduino.h>

#include "../Software/src/battery/BMW-I3-BATTERY.h"
#include "../Software/src/battery/BMW-SBOX.h"
#include "../Software/src/communication/contactorcontrol/comm_contactorcontrol.h"
#include "../Software/src/datalayer/datalayer.h"
#include "../Software/src/devboard/hal/hal.h"
#include "../Software/src/devboard/safety/safety.h"
#include "../Software/src/devboard/utils/events.h"

extern const std::vector<CAN_frame>& get_transmitted_frames();
extern void clear_transmitted_frames();

namespace {

std::string FrameLine(const CAN_frame& f) {
  char buf[96];
  int n = snprintf(buf, sizeof(buf), "%03X", (unsigned)f.ID);
  std::string s(buf, n);
  for (int i = 0; i < f.DLC && i < 8; ++i) {
    n = snprintf(buf, sizeof(buf), " %02X", f.data.u8[i]);
    s += std::string(buf, n);
  }
  return s;
}

std::vector<std::string> Actual(const std::vector<CAN_frame>& frames, uint32_t id_filter) {
  std::vector<std::string> out;
  for (const auto& f : frames) {
    if (f.ID == id_filter) {
      out.push_back(FrameLine(f));
    }
  }
  return out;
}

std::vector<std::string> Golden(const std::string& name) {
  std::vector<std::string> out;
  // CMake copies the traces next to the test binary.
  std::ifstream in("contactor_traces/" + name + ".trace");
  EXPECT_TRUE(in.good()) << "missing golden trace: " << name;
  for (std::string line; std::getline(in, line);) {
    if (!line.empty()) {
      out.push_back(line);
    }
  }
  return out;
}

void ExpectSameTrace(const std::string& name, const std::vector<std::string>& actual) {
  const std::vector<std::string> golden = Golden(name);
  ASSERT_EQ(golden.size(), actual.size()) << name << ": frame COUNT differs - the refactor changed the "
                                          << "transmit cadence, not just the content";
  for (size_t i = 0; i < golden.size(); ++i) {
    ASSERT_EQ(golden[i], actual[i]) << name << ": frame " << i << " differs (1-based line " << (i + 1)
                                    << " of the .trace)";
  }
}

// Every scenario starts from the same baseline: nothing else in the system is
// blocking, so the trace isolates the contactor logic.
void ResetWorld() {
  datalayer = DataLayer();
  reset_all_events();
  init_hal();
  set_millis64(0);
  clear_transmitted_frames();
  // The parallel-join arbiter is new in this series and defaults to blocked
  // until setup_battery() runs. These scenarios are single-battery, which is
  // the case the gate is designed not to affect, so grant it explicitly -
  // otherwise we would be comparing "gate open" against "gate absent".
  datalayer.system.status.battery_link[0].allowed_contactor_closing = true;
}

struct I3Inputs {
  bool inverter_allows = true;
  bool equipment_stop = false;
  bool fault = false;
  uint8_t reported_switch = 0;  // 0 open, 1 precharging, 2 engaged, 3 invalid
};

void FeedI3Status(BmwI3Battery& b, uint8_t disconnecting_switch) {
  // 0x112 keeps the pack awake; 0x1FA byte 1 bits 4-5 carry the DC-switch
  // status the contactor logic reads back.
  CAN_frame alive = {.FD = false, .ext_ID = false, .DLC = 8, .ID = 0x112, .data = {}};
  b.handle_incoming_can_frame(alive);
  CAN_frame sw = {.FD = false, .ext_ID = false, .DLC = 8, .ID = 0x1FA, .data = {}};
  sw.data.u8[1] = (uint8_t)((disconnecting_switch & 0x03) << 4);
  b.handle_incoming_can_frame(sw);
}

std::vector<std::string> RunI3(const std::vector<std::pair<unsigned long, I3Inputs>>& script) {
  ResetWorld();
  BmwI3Battery battery(&datalayer.batteries[0], nullptr, CAN_NATIVE, esp32hal->WUP_PIN1());
  battery.setup();

  for (const auto& step : script) {
    set_millis64(step.first);
    const I3Inputs& in = step.second;
    datalayer.system.status.inverter_allows_contactor_closing = in.inverter_allows;
    datalayer.system.info.equipment_stop_active = in.equipment_stop;
    datalayer.system.status.system_status = in.fault ? FAULT : ACTIVE;
    FeedI3Status(battery, in.reported_switch);
    battery.update_values();
    battery.transmit_can(step.first);
  }
  return Actual(get_transmitted_frames(), 0x10B);
}

struct SboxInputs {
  bool inverter_allows = true;
  bool equipment_stop = false;
  bool fault = false;
  bool battery_allows = true;
  uint32_t in_mV = 400000;
  uint32_t out_mV = 400000;
};

std::vector<std::string> RunSbox(const std::vector<std::pair<unsigned long, SboxInputs>>& script) {
  ResetWorld();
  BmwSbox shunt;
  shunt.setup();

  for (const auto& step : script) {
    set_millis64(step.first);
    const SboxInputs& in = step.second;
    datalayer.system.status.inverter_allows_contactor_closing = in.inverter_allows;
    datalayer.system.info.equipment_stop_active = in.equipment_stop;
    datalayer.system.status.system_status = in.fault ? FAULT : ACTIVE;
    datalayer.system.status.battery_link[0].allows_contactor_closing = in.battery_allows;
    datalayer.shunt.measured_voltage_mV = in.in_mV;
    datalayer.shunt.measured_outvoltage_mV = in.out_mV;
    shunt.transmit_can(step.first);
  }
  return Actual(get_transmitted_frames(), 0x100);
}

// ---- scenarios (must stay identical to the generator's) ---------------------

std::vector<std::pair<unsigned long, I3Inputs>> I3ScriptCloseThenFault() {
  std::vector<std::pair<unsigned long, I3Inputs>> s;
  unsigned long t = 0;
  for (int i = 0; i < 200; ++i) {
    I3Inputs in;
    in.reported_switch = 0;
    s.push_back({t += 20, in});
  }
  for (int i = 0; i < 10; ++i) {
    I3Inputs in;
    in.reported_switch = 1;
    s.push_back({t += 20, in});
  }
  for (int i = 0; i < 10; ++i) {
    I3Inputs in;
    in.reported_switch = 2;
    s.push_back({t += 20, in});
  }
  for (int i = 0; i < 10; ++i) {
    I3Inputs in;
    in.reported_switch = 2;
    in.fault = true;
    s.push_back({t += 20, in});
  }
  for (int i = 0; i < 10; ++i) {
    I3Inputs in;
    in.reported_switch = 2;
    s.push_back({t += 20, in});
  }
  return s;
}

std::vector<std::pair<unsigned long, I3Inputs>> I3ScriptInverterRevoke() {
  std::vector<std::pair<unsigned long, I3Inputs>> s;
  unsigned long t = 0;
  for (int i = 0; i < 200; ++i) {
    I3Inputs in;
    s.push_back({t += 20, in});
  }
  for (int i = 0; i < 10; ++i) {
    I3Inputs in;
    in.reported_switch = 2;
    s.push_back({t += 20, in});
  }
  for (int i = 0; i < 10; ++i) {
    I3Inputs in;
    in.reported_switch = 2;
    in.inverter_allows = false;
    s.push_back({t += 20, in});
  }
  return s;
}

std::vector<std::pair<unsigned long, I3Inputs>> I3ScriptEquipmentStop() {
  std::vector<std::pair<unsigned long, I3Inputs>> s;
  unsigned long t = 0;
  for (int i = 0; i < 200; ++i) {
    I3Inputs in;
    s.push_back({t += 20, in});
  }
  for (int i = 0; i < 10; ++i) {
    I3Inputs in;
    in.reported_switch = 2;
    s.push_back({t += 20, in});
  }
  for (int i = 0; i < 10; ++i) {
    I3Inputs in;
    in.reported_switch = 2;
    in.equipment_stop = true;
    s.push_back({t += 20, in});
  }
  return s;
}

std::vector<std::pair<unsigned long, SboxInputs>> SboxScriptFullPrecharge() {
  std::vector<std::pair<unsigned long, SboxInputs>> s;
  unsigned long t = 0;
  for (int i = 0; i < 1400; ++i) {
    SboxInputs in;
    s.push_back({t += 10, in});
  }
  return s;
}

std::vector<std::pair<unsigned long, SboxInputs>> SboxScriptPrechargeRatioBlocked() {
  std::vector<std::pair<unsigned long, SboxInputs>> s;
  unsigned long t = 0;
  for (int i = 0; i < 1400; ++i) {
    SboxInputs in;
    in.out_mV = 100000;
    s.push_back({t += 10, in});
  }
  return s;
}

std::vector<std::pair<unsigned long, SboxInputs>> SboxScriptFaultLatch() {
  std::vector<std::pair<unsigned long, SboxInputs>> s;
  unsigned long t = 0;
  for (int i = 0; i < 1400; ++i) {
    SboxInputs in;
    s.push_back({t += 10, in});
  }
  for (int i = 0; i < 2500; ++i) {
    SboxInputs in;
    in.fault = true;
    s.push_back({t += 10, in});
  }
  for (int i = 0; i < 100; ++i) {
    SboxInputs in;
    s.push_back({t += 10, in});
  }
  return s;
}

}  // namespace

// The i3 commands its contactors over 0x10B byte 1 and follows the switch state
// its own BMS reports. The refactor turned a flat if/else chain re-evaluated
// every 20 ms into a state machine, so the close COMMAND and the open paths are
// where a divergence would show.

TEST(ContactorEquivalence, I3ClosesAfterGraceAndOpensOnFault) {
  ExpectSameTrace("i3_close_then_fault", RunI3(I3ScriptCloseThenFault()));
}

TEST(ContactorEquivalence, I3OpensWhenInverterRevokesPermission) {
  ExpectSameTrace("i3_inverter_revoke", RunI3(I3ScriptInverterRevoke()));
}

// DELIBERATE DIVERGENCE, asserted rather than hidden.
//
// Pre-refactor, the i3 had no equipment-stop handling in its contactor command
// at all: it kept commanding CLOSE for the entire stop and relied solely on the
// wakeup pin dropping to put the pack to sleep. The shared FSM gates every
// topology on equipment_stop_active, so the i3 now commands OPEN from the first
// stop tick.
//
// This test pins BOTH halves: everything before the stop is byte-identical to
// the old implementation (no accidental drift), and the change after it is
// exactly one thing - the close command releasing. If either half moves, this
// fails.
TEST(ContactorEquivalence, I3EquipmentStopReleasesTheCloseCommand) {
  const std::vector<std::string> golden = Golden("i3_equipment_stop");
  const std::vector<std::string> actual = RunI3(I3ScriptEquipmentStop());
  ASSERT_EQ(golden.size(), actual.size()) << "transmit cadence must be unchanged";

  // The script runs 200 startup + 10 engaged frames before asserting the stop,
  // and the FSM releases the command one tick later: the COMPLETED ->
  // DISCONNECTED transition returns, and the actuator opens on the following
  // tick. So frame 210 still commands close in both implementations and the
  // divergence starts at 211 - a 20 ms lag, measured here rather than assumed.
  constexpr size_t kStopBegins = 211;
  ASSERT_GT(golden.size(), kStopBegins);

  for (size_t i = 0; i < kStopBegins; ++i) {
    ASSERT_EQ(golden[i], actual[i]) << "frame " << i << " before the equipment stop must be identical";
  }

  // Line layout: "10B b0 b1 b2" - byte 1 holds the contactor command in its
  // high nibble (0x1 close, 0x0 open) and the alive counter in its low nibble.
  // Byte 0 is the CRC over the frame, so it necessarily moves with the command.
  constexpr size_t kCmdNibble = 7;
  constexpr size_t kCounterNibble = 8;
  for (size_t i = kStopBegins; i < golden.size(); ++i) {
    const std::string& g = golden[i];
    const std::string& a = actual[i];
    ASSERT_EQ('1', g[kCmdNibble]) << "the OLD behaviour under test was: keep commanding close through the stop";
    ASSERT_EQ('0', a[kCmdNibble]) << "frame " << i << ": equipment stop must release the close command";
    ASSERT_EQ(g[kCounterNibble], a[kCounterNibble]) << "frame " << i << ": the alive counter must keep its cadence";
    ASSERT_EQ(g.substr(9), a.substr(9)) << "frame " << i << ": no byte beyond the command may change";
  }
}

// The S-BOX drives relays over 0x100 byte 0 in its own order (precharge relay
// first, then negative, then positive, then release), with its own T1/T2/T3
// timings and a precharge voltage-ratio guard before the positive relay.

TEST(ContactorEquivalence, SboxRunsItsPrechargeSequence) {
  ExpectSameTrace("sbox_full_precharge", RunSbox(SboxScriptFullPrecharge()));
}

TEST(ContactorEquivalence, SboxHoldsPositiveWhilePrechargeRatioUnmet) {
  ExpectSameTrace("sbox_ratio_blocked", RunSbox(SboxScriptPrechargeRatioBlocked()));
}

TEST(ContactorEquivalence, SboxLatchesOnFaultAndStopsTransmitting) {
  ExpectSameTrace("sbox_fault_latch", RunSbox(SboxScriptFaultLatch()));
}
